## config/west.yml
```yaml
manifest:
  remotes:
    - name: zmkfirmware
      url-base: https://github.com/zmkfirmware
    - name: kumamuk-git
      url-base: https://github.com/kumamuk-git
    - name: lukytto
      url-base: https://github.com/lukytto

  projects:

    - name: zmk

      remote: zmkfirmware

      revision: main

      import: app/west.yml

    - name: zmk-pmw3610-driver

      remote: lukytto

      revision: main

  self:

    path: config
```
